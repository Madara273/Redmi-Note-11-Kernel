## drivers/net/wireless/mediatek/mt7601u/Kconfig
```kconfig
config MT7601U
	tristate "MediaTek MT7601U (USB) support"
	depends on MAC80211
	depends on USB
	depends on NETHUNTER_SUPPORT
	default y
	---help---
	  This adds support for MT7601U-based wireless USB dongles.
```

## drivers/staging/rtl8188eus/Kconfig
```kconfig
config RTL8188EU
	tristate "Realtek 8188E USB WiFi"
	depends on USB
	depends on NETHUNTER_SUPPORT
	default m
	---help---
	  Help message of RTL8188EU
```
